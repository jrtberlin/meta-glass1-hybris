## conf/layer.conf
```bitbake
BBPATH .= ":${LAYERDIR}"
BBFILES += "${LAYERDIR}/recipes*/*/*.bb ${LAYERDIR}/recipes*/*/*.bbappend"
BBFILE_COLLECTIONS += "glass1-hybris-layer"
BBFILE_PATTERN_glass1-hybris-layer := "^${LAYERDIR}/"
BBFILE_PRIORITY_glass1-hybris-layer = "7"
LAYERSERIES_COMPAT_glass1-hybris-layer = "warrior"
```

## conf/machine/glass1.conf
```bitbake
#@TYPE: Machine
#@NAME: Google Glass 1
#@DESCRIPTION: Machine configuration for the Google Glass Explorer Edition

#require conf/machine/include/tune-cortexa9.inc
require conf/machine/include/hybris-watch.inc
require conf/machine/include/arm/arch-armv7ve.inc

ARM_INSTRUCTION_SET = "thumb"

KERNEL_IMAGETYPE = "zImage"
PREFERRED_VERSION_android = "kitkat"

PREFERRED_PROVIDER_virtual/kernel = "linux-glass1"
PREFERRED_VERSION_linux = "4.14+kitkat"

IMAGE_INSTALL += "brcm-patchram-plus underclock asteroid-compass"
```
